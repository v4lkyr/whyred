## techpack/audio/Kconfig
```kconfig
config TECHPACK_PROFILE
	string "Configuration profile for Qualcomm Sound Techpack module"
	default "whyred"
	help
	  Specify which configuration profile to be used for building
	  this module.
	  Profiles are located at techpack/audio/config.
```
